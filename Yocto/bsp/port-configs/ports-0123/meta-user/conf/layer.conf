## Yocto/bsp/port-configs/ports-0123/meta-user/conf/layer.conf
```bitbake
# Copyright (C) 2025-2026, Opsero Electronic Design Inc.  All rights reserved.
#
# SPDX-License-Identifier: MIT

# Per-target Ethernet port-config overlay layer. Added to bblayers.conf by
# Yocto/scripts/configure-build.sh ALONGSIDE the board meta-user layer, so its
# device-tree.bbappend applies on top. Distinct BBFILE_COLLECTIONS name
# ("port-config") so it does not clash with the board layer's "meta-user".
BBPATH .= ":${LAYERDIR}"

BBFILES += "${LAYERDIR}/recipes-*/*/*.bb \
	${LAYERDIR}/recipes-*/*/*.bbappend"

BBFILE_COLLECTIONS += "port-config"
BBFILE_PATTERN_port-config = "^${LAYERDIR}/"
BBFILE_PRIORITY_port-config = "8"
LAYERSERIES_COMPAT_port-config = "scarthgap"
```
