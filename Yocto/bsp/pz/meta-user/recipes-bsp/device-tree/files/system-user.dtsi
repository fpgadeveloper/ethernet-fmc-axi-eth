// SPDX-License-Identifier: MIT
// Copyright (C) 2025-2026, Opsero Electronic Design Inc.  All rights reserved.

/*
 * SoC-side board fixups for PicoZed (Zynq-7000), layered on top of the
 * gen-machineconf / lopper-generated cortexa9-linux.dts (which already carries
 * this board's PS config and the PL AXI Ethernet cores from its XSA). Scoped to
 * the Linux domain by device-tree.bbappend. The external-PHY wiring for the AXI
 * Ethernet ports (FMC ports 0-3) is supplied separately by the bsp/port-configs
 * overlay (port-config.dtsi), not here.
 *
 * compatible: the parse-sdt/lopper board merge overwrites the root compatible
 * with only the board string and drops the SoC-family "xlnx,zynq-7000" that the
 * base zynq-7000.dtsi sets. The kernel's Zynq machine matches on
 * "xlnx,zynq-7000"; without it the kernel falls back to the generic ARM DT
 * machine, zynq_early_slcr_init() never runs, and the clock PLL setup
 * NULL-derefs -> panic during of_clk_init. Put it back.
 *
 * bootargs: not set here. The kernel command line comes from
 * BSP_EXTRA_BOOTARGS (conf/local.conf.append), appended to the boot.scr
 * "setenv bootargs" line by meta-user/recipes-bsp/u-boot/u-boot-edf-scr_%.bbappend
 * (parse-sdt emits no /chosen/bootargs on Zynq-7000).
 *
 * gem0: the board Ethernet port, kept enabled so the image is reachable over
 * the board RJ45 (the FMC ports are the PL AXI Ethernet cores). The generated
 * pcw.dtsi enables gem0 but describes no PHY (no phy-handle, no MDIO child);
 * 2025.x U-Boot data-aborts probing a gem0 in that state, so the PHY is
 * described here. This dtb is also U-Boot's control DT (BOOT.BIN loads it at
 * 0x100000), so U-Boot sees the same description.
 * board RJ45 = PS GEM0 on MIO16-27 (RGMII), MDIO on MIO52/53, Marvell
 * 88E151x PHY on the PicoZed SOM at MDIO address 0, phy-mode rgmii-id (the
 * PicoZed PetaLinux BSP heritage in fpga-drive-aximm-pcie; PS config of this
 * design's XSA).
 * No fixed MAC: U-Boot assigns one and passes it on.
 */

/ {
	compatible = "xlnx,zynq-7000";
};

&gem0 {
	status = "okay";
	phy-mode = "rgmii-id";
	phy-handle = <&gem0_phy>;
	xlnx,has-mdio = <0x1>;
	mdio {
		#address-cells = <1>;
		#size-cells = <0>;
		gem0_phy: phy@0 {
			device_type = "ethernet-phy";
			reg = <0>;
		};
	};
};
