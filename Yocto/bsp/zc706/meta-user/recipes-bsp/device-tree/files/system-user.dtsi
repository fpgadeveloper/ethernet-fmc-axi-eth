// SPDX-License-Identifier: MIT
// Copyright (C) 2025-2026, Opsero Electronic Design Inc.  All rights reserved.

/*
 * SoC-side board fixups for ZC706 (Zynq-7000), layered on top of the
 * gen-machineconf / lopper-generated cortexa9-linux.dts (which already carries
 * this board's PS config and the PL AXI Ethernet cores from its XSA). Scoped to
 * the Linux domain by device-tree.bbappend. The external-PHY wiring for the AXI
 * Ethernet ports is supplied separately by the bsp/port-configs overlay
 * (port-config.dtsi), not here.
 *
 * compatible: the parse-sdt/lopper board merge overwrites the root compatible
 * with only the board string and drops the SoC-family "xlnx,zynq-7000" that the
 * base zynq-7000.dtsi sets. The kernel's Zynq machine matches on
 * "xlnx,zynq-7000"; without it the kernel falls back to the generic ARM DT
 * machine, zynq_early_slcr_init() never runs, and the clock PLL setup
 * NULL-derefs -> panic during of_clk_init. Put it back.
 *
 * bootargs: the Zynq-7000 EDF boot.scr reads bootargs from /chosen/bootargs and
 * only appends root=; parse-sdt emits no default bootargs, so without this the
 * kernel boots with no console/earlycon and appears to hang. console=ttyPS0 is
 * the board console; cma is modest (fits ZedBoard's 512 MB DDR).
 *
 * gem0: this design uses the PL AXI Ethernet cores, not the PS GEM. pcw.dtsi
 * leaves gem0 without a phy-handle, which makes 2025.x u-boot data-abort while
 * probing it. Mirrors the PetaLinux BSP.
 */

/ {
	compatible = "xlnx,zynq-7000";

	chosen {
		bootargs = "earlycon console=ttyPS0,115200 clk_ignore_unused cma=256M";
	};
};

&gem0 {
	status = "disabled";
};
